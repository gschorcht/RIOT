## boards/adafruit-metro-esp32s2/Kconfig
```kconfig
# SPDX-FileCopyrightText: 2026 Gunar Schorcht
# SPDX-License-Identifier: LGPL-2.1-only

config BOARD
    default "adafruit-metro-esp32s2" if BOARD_ADAFRUIT_METRO_ESP32S2

config BOARD_ADAFRUIT_METRO_ESP32S2
    bool
    default y
    select BOARD_COMMON_ESP32S2
    select CPU_MODEL_ESP32S2_WROVER_N4R2

source "$(RIOTBOARD)/common/esp32s2/Kconfig"
```

## boards/adafruit-metro-esp32s3/Kconfig
```kconfig
# SPDX-FileCopyrightText: 2026 Gunar Schorcht
# SPDX-License-Identifier: LGPL-2.1-only

config BOARD
    default "adafruit-metro-esp32s3" if BOARD_ADAFRUIT_METRO_ESP32S3

config BOARD_ADAFRUIT_METRO_ESP32S3
    bool
    default y
    select BOARD_COMMON_ESP32S3
    select CPU_MODEL_ESP32S3_WROOM_1X_N16R8

source "$(RIOTBOARD)/common/esp32s3/Kconfig"
```

## boards/m5stack-atom-matrix-esp32/Kconfig
```kconfig
# SPDX-FileCopyrightText: 2026 Gunar Schorcht
# SPDX-License-Identifier: LGPL-2.1-only

config BOARD
    default "m5stack-atom-matrix-esp32" if BOARD_M5STACK_ATOM_MATRIX_ESP32

config BOARD_M5STACK_ATOM_MATRIX_ESP32
    bool
    default y
    select BOARD_COMMON_ESP32
    select CPU_MODEL_ESP32_PICO_D4

source "$(RIOTBOARD)/common/esp32/Kconfig"
```
